## components/airflash/Kconfig.projbuild
```kconfig
menu "airflash"
    config AIRFLASH_WIFI_ENABLE
        bool "Connect to Wi-Fi inside airflash_start()"
        default n
        help
            Turn ON only if your app has no networking of its own. Apps that already connect
            (example_connect(), own Wi-Fi code, Ethernet) leave this off and call
            airflash_start() after the network is up.

    config AIRFLASH_WIFI_SSID
        string "Wi-Fi SSID (2.4 GHz)"
        depends on AIRFLASH_WIFI_ENABLE

    config AIRFLASH_WIFI_PASSWORD
        string "Wi-Fi password"
        depends on AIRFLASH_WIFI_ENABLE

    config AIRFLASH_HOSTNAME
        string "mDNS hostname (<name>.local), empty = airflash-XXXX"
        default ""
        help
            Empty: airflash-XXXX, XXXX = the last 4 hex digits of the Wi-Fi MAC (e.g. airflash-9220),
            so several boards on one network don't all claim the same name. The updater and the
            airflash component use the same rule, so a board keeps one name in the app and the updater.
            Also sent as the DHCP hostname (router's client list) where airflash brings up Wi-Fi itself.

    config AIRFLASH_HTTP_PORT
        int "Control port (HTTP: /info, /reboot-to-updater)"
        default 8080
        help
            Not 80: the updater uses 80, and many apps run their own web server there.
            If the app already uses this port, airflash logs an error at boot and the app runs without it.

    config AIRFLASH_HTTP_CTRL_PORT
        int "Control server's internal port (UDP, 127.0.0.1 only)"
        default 32800
        range 1024 65535
        help
            Every esp_http_server instance needs an internal UDP socket on 127.0.0.1 (its "ctrl_port"),
            and it must be unique per server: two servers on one port can't both start. It's never
            reachable from the network. Apps keep IDF's default 32768 for their own server and usually
            take 32769 for a second one (e.g. the ESP32 camera web server), so airflash uses 32800.
            Change it only if your app already uses this port.

    config AIRFLASH_LOG_PORT
        int "Log stream port (TCP)"
        default 3333
        help
            Read it with `idf.py airflash-monitor` or `airflash.py logs`. Each connection starts with a
            challenge-response (the board's pairing token), so plain `nc <ip> 3333` and
            `idf.py -p socket://<ip>:3333 monitor` don't work.

    config AIRFLASH_LOG_CLIENTS
        int "Log viewers at the same time"
        default 3
        range 1 5
        help
            e.g. `airflash.py logs` and `idf.py airflash-monitor` side by side. Each viewer uses one lwIP socket
            (CONFIG_LWIP_MAX_SOCKETS, default 10, shared with your app).

    config AIRFLASH_LOG_BUF_SIZE
        int "Log ring buffer size (bytes)"
        default 16384
        range 2048 65536
        help
            Recent logs kept in internal RAM. They survive software resets, crashes and watchdog resets
            (not power-off), so the lines before a crash can still be read after the reboot.
            Not PSRAM: its cache is thrown away on reset, losing exactly the newest lines.
            Each new stream connection replays what's still in here.

    config AIRFLASH_ROM_LOGS
        bool "Also capture esp_rom_printf output"
        default y
        help
            Uses the ROM's second printf channel, so ESP_EARLY_LOGx lines (most startup lines), the task
            watchdog report and the core dump's "saved" lines also reach the stream.

    config AIRFLASH_EARLY_LOGS
        bool "Capture logs from before app_main()"
        default y
        help
            Starts capturing at the very start of the app: on IDF 5.3+ from the first startup stage,
            before the CPU frequency, app info, chip revision, heap and flash lines; the ESP_LOGx hook
            follows from a global constructor, still before app_main(). Off: capturing starts in
            airflash_start().

    config AIRFLASH_PANIC_TEXT
        bool "Capture the panic handler's own text (Guru Meditation, registers, backtrace)"
        default y
        depends on !ESP_SYSTEM_PANIC_SILENT_REBOOT
        help
            The panic handler writes straight to the UART/USB hardware, past every log hook. With this on,
            airflash intercepts its print functions at link time (-Wl,--wrap) and copies the text into
            the log buffer too, so the stream shows the crash just as the serial monitor did.
            Needs IDF 5.2+; skipped when the BLE controller's "wrap panic handler" log option is on.
            When off (or nothing was captured), the next boot prints a summary rebuilt from the core dump.

    config AIRFLASH_COREDUMP_LOG_TAIL
        int "Log bytes stored inside the core dump (0 = off)"
        default 4096
        range 0 16384
        depends on ESP_COREDUMP_ENABLE_TO_FLASH && ESP_COREDUMP_DATA_FORMAT_ELF
        help
            The newest N bytes of the crashed boot's logs, kept in a RAM area every core dump saves.
            The log buffer itself is gone once the updater takes over after a rollback; the core dump
            stays in flash, so `airflash.py coredump` can still show the lines before the crash.
            Costs N bytes of internal RAM, N bytes of app image (it's initialized data) and N bytes
            of core dump.

    config AIRFLASH_ROLLBACK_TIMEOUT_S
        int "Seconds a newly flashed app gets to get on the network (0 = no limit)"
        default 60
        range 0 3600
        help
            Only on the first boot after a flash, while the app is still pending verify. The app is on
            the network once airflash_start() has run and an interface (Wi-Fi or Ethernet) has an IPv4
            address; then it's confirmed (see below). If not in time (wrong Wi-Fi password,
            airflash_start() never reached, ...), airflash aborts with the reason, e.g.
            "airflash: not on the network 60 s after boot (Wi-Fi 'home': reason 15 4WAY_HANDSHAKE_TIMEOUT)".
            The core dump keeps that message, and the bootloader rolls back to the updater, so the
            board stays reachable for the next flash. An app that confirms itself in time also ends it.

    config AIRFLASH_AUTO_MARK_VALID
        bool "Confirm a new app as soon as it's on the network"
        default y
        help
            Turn OFF to confirm it yourself with esp_ota_mark_app_valid_cancel_rollback() once your
            app is healthy. Until then any reset sends the board back to the updater.

    config AIRFLASH_CRASH_LOOP_COUNT
        int "Park the app in the updater after this many crashes in a row right after boot (0 = off)"
        default 3
        range 0 100
        help
            A confirmed app that crashes (panic or watchdog) on every boot before it's on the network can
            never be reached again. After this many such boots in a row, airflash marks it invalid: the
            bootloader starts the updater instead (its /info says running_because: app_crash_loop),
            ready for a fixed build. Brownout, power-on and software resets never count, and neither
            does the first boot after a flash (the rollback handles that one).

    config AIRFLASH_CRASH_LOOP_WINDOW_S
        int "A crash counts if it happens within this many seconds of boot"
        default 30
        range 1 3600
        depends on AIRFLASH_CRASH_LOOP_COUNT != 0
endmenu
```

## components/remote_flash/Kconfig.projbuild
```kconfig
menu "Remote Flash"
    config RF_WIFI_ENABLE
        bool "Connect to Wi-Fi inside remote_flash_start()"
        default y
        help
            Turn OFF if your project already brings up the network itself
            (example_connect(), its own Wi-Fi code, Ethernet...). Then call
            remote_flash_start() after the network is up.

    config RF_WIFI_SSID
        string "Wi-Fi SSID"
        depends on RF_WIFI_ENABLE

    config RF_WIFI_PASSWORD
        string "Wi-Fi password"
        depends on RF_WIFI_ENABLE

    config RF_HOSTNAME
        string "mDNS hostname (<name>.local)"
        default "esp32"
        help
            Give every board on the same network a different name.

    config RF_TOKEN
        string "X-Token required for /update and /logs (max 63 chars, empty = no auth)"
        default ""

    config RF_HTTP_PORT
        int "HTTP port"
        default 80
        help
            Change if your project already runs its own web server on port 80.

    config RF_LOG_BUF_SIZE
        int "Log ring buffer size (bytes)"
        default 16384
        range 1024 262144
        help
            RAM used to keep recent logs. /logs briefly allocates the same amount again.

    config RF_ROLLBACK_TIMEOUT_S
        int "Seconds new firmware gets to reach Wi-Fi before rolling back"
        default 60
        depends on RF_WIFI_ENABLE

    config RF_AUTO_MARK_VALID
        bool "Mark new firmware valid as soon as the OTA server is up"
        default y
        help
            Turn OFF to confirm it yourself with esp_ota_mark_app_valid_cancel_rollback()
            once your app is healthy (e.g. camera/audio init succeeded). Until then
            any reset rolls back to the previous firmware.
endmenu
```

## updater/main/Kconfig.projbuild
```kconfig
menu "airflash"
    config UPD_WIFI_SSID
        string "Wi-Fi SSID (2.4 GHz)"

    config UPD_WIFI_PASSWORD
        string "Wi-Fi password"

    config UPD_HOSTNAME
        string "mDNS hostname (<name>.local), empty = airflash-XXXX"
        default ""
        help
            Empty: airflash-XXXX, XXXX = the last 4 hex digits of the Wi-Fi MAC (e.g. airflash-9220),
            so several boards on one network don't all claim the same name. The updater and the
            airflash component use the same rule, so a board keeps one name in the app and the updater.
            Also sent as the DHCP hostname (router's client list) where airflash brings up Wi-Fi itself.

    config UPD_TOKEN
        string "Pairing token (empty = generate one)"
        default ""
        help
            Empty: the build creates a random token once per laptop (~/.airflash/token) and uses it for
            every board installed from this laptop.
            Set: use this token instead (printable ASCII without spaces, 1-63 characters), e.g. one shared
            by a team. If ~/.airflash/token doesn't exist yet, the build saves it there for the airflash tool.
            Stored only in this sdkconfig and in the board's upd_cfg partition, never compiled into the
            firmware. A random token is stronger than a short custom one.
endmenu
```
